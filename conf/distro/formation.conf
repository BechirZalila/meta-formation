## conf/distro/formation.conf
```bitbake
require conf/distro/poky.conf

DISTRO = "formation"
DISTRO_NAME = "Distribution exemple pour la formation"
DISTRO_VERSION = "1.0"
MAINTAINER = "admin@example.com"

# Sélection de systemd comme unique gestionnaire de démarrage pour
# cette distribution
DISTRO_FEATURES:append = " systemd"
VIRTUAL-RUNTIME_init_manager = "systemd"
DISTRO_FEATURES_BACKFILL_CONSIDERED = "sysvinit"
VIRTUAL-RUNTIME_initscripts = ""
```

## conf/layer.conf
```bitbake
# We have a conf and classes directory, add to BBPATH
BBPATH .= ":${LAYERDIR}"

# We have recipes-* directories, add to BBFILES
BBFILES += "${LAYERDIR}/recipes-*/*/*.bb \
            ${LAYERDIR}/recipes-*/*/*.bbappend"

BBFILE_COLLECTIONS += "meta-formation"
BBFILE_PATTERN_meta-formation = "^${LAYERDIR}/"
BBFILE_PRIORITY_meta-formation = "6"

LAYERDEPENDS_meta-formation = "core"
LAYERSERIES_COMPAT_meta-formation = "kirkstone"
```
